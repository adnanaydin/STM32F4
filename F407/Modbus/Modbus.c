#include <stdio.h>
#include <stdlib.h>
#include <string.h>
#include <ctype.h>

#include "io.h"
#include "system.h"
#include "uart.h"
#include "fifo.h"
#include "timer.h"
#include "button.h"
#include "oled.h"

#define MB_DEVICE       0x01
#define MB_TIMEOUT      1000

#define MBU_BAUD        9600
#define MBU_ST          USART2
#define MBU_PORT        UART_2
#define MBU_IRQn        USART2_IRQn
#define MBU_IRQHandler  USART2_IRQHandler

#define MBT_FREQ        SystemCoreClock
#define MBT_TIMEOUT     1000
#define MBT_PORT        TIMER_3
#define MBT_ST          TIM3
#define MBT_IRQHandler  TIM3_IRQHandler

#define SZ_BUF          1024

#define SZ_ADU          256
#define SZ_PDU          253

// Sorgu ve yanýt mesaj alanlarý
static uint8_t _mb_req_adu[SZ_ADU];
static uint8_t _mb_rsp_adu[SZ_ADU];

// Sorgu ve yanýt mesajlarý uzunluðu (byte olarak)
static uint8_t _mb_req_len;
static uint8_t _mb_rsp_len;

static unsigned char _RxBuf[SZ_BUF];
static unsigned char _TxBuf[SZ_BUF];

static FIFO     _RxFifo;
static FIFO     _TxFifo;

volatile int    g_TxFlag;

////////////////////////////////////////////////////////////////////////////////

void SwapUint16(void *buf)
{
  uint8_t temp;
  uint8_t *pVal = (uint8_t *)buf;
  
  temp = pVal[0];
  pVal[0] = pVal[1];
  pVal[1] = temp;
}

/* Table of CRC values for high–order byte */
static const uint8_t CRCtabHi[] = {
0x00, 0xC1, 0x81, 0x40, 0x01, 0xC0, 0x80, 0x41, 0x01, 0xC0, 0x80, 0x41, 0x00, 0xC1, 0x81,
0x40, 0x01, 0xC0, 0x80, 0x41, 0x00, 0xC1, 0x81, 0x40, 0x00, 0xC1, 0x81, 0x40, 0x01, 0xC0,
0x80, 0x41, 0x01, 0xC0, 0x80, 0x41, 0x00, 0xC1, 0x81, 0x40, 0x00, 0xC1, 0x81, 0x40, 0x01,
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0x00, 0xC1, 0x81, 0x40, 0x01, 0xC0, 0x80, 0x41, 0x01, 0xC0, 0x80, 0x41, 0x00, 0xC1, 0x81,
0x40
};

/* Table of CRC values for low–order byte */
static const uint8_t CRCtabLo[] = {
0x00, 0xC0, 0xC1, 0x01, 0xC3, 0x03, 0x02, 0xC2, 0xC6, 0x06, 0x07, 0xC7, 0x05, 0xC5, 0xC4,
0x04, 0xCC, 0x0C, 0x0D, 0xCD, 0x0F, 0xCF, 0xCE, 0x0E, 0x0A, 0xCA, 0xCB, 0x0B, 0xC9, 0x09,
0x08, 0xC8, 0xD8, 0x18, 0x19, 0xD9, 0x1B, 0xDB, 0xDA, 0x1A, 0x1E, 0xDE, 0xDF, 0x1F, 0xDD,
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0x44, 0x84, 0x85, 0x45, 0x87, 0x47, 0x46, 0x86, 0x82, 0x42, 0x43, 0x83, 0x41, 0x81, 0x80,
0x40
};

// MODBUS 16-bit CRC fonksiyonu
uint16_t CRC16(uint8_t *pMsg, uint8_t len)
{
  uint16_t crc = 0xFFFF;
  uint8_t crcHi = crc >> 8; 	/* high byte of CRC initialized */
  uint8_t crcLo = crc & 0xFF; /* low byte of CRC initialized */
  uint8_t idx ; /* will index into CRC lookup table */

  while (len--) 
  {
    idx = crcHi ^ *pMsg++ ; /* calculate the CRC */
    crcHi = crcLo ^ CRCtabHi[idx];
    crcLo = CRCtabLo[idx] ;
  }

  crc = ((uint16_t)crcHi << 8 | crcLo);
  SwapUint16(&crc);  
  
  return crc;
}

////////////////////////////////////////////////////////////////////////////////

void MB_TimerInit(void)
{
  Timer_Init(MBT_PORT, 36, MBT_FREQ / MBU_BAUD, 1);
  Timer_IntConfig(MBT_PORT, 4);
}

void MB_TimerStart(void)
{
  Timer_Reset(MBT_PORT);
  Timer_Start(MBT_PORT, 1);
}

void MB_TimerStop(void)
{
  Timer_Start(MBT_PORT, 0);
  Timer_Reset(MBT_PORT);
}

void MBT_IRQHandler(void)
{
  if (TIM_GetITStatus(MBT_ST, TIM_IT_Update)) {
    _mb_rsp_len = FIFO_GetCount(&_RxFifo);
    
    MB_TimerStop();
    TIM_ClearITPendingBit(MBT_ST, TIM_IT_Update);
  }
}

////////////////////////////////////////////////////////////////////////////////

void MB_UartInit(int baud)
{
  // MB UART baþlangýç
  UART_Init(MBU_PORT, baud);
  
  // FIFO baþlangýç
  FIFO_Init(&_RxFifo, _RxBuf, SZ_BUF);
  FIFO_Init(&_TxFifo, _TxBuf, SZ_BUF);
  
  // MB UART kesme ayarlarý
  // a) ST yakasý
  USART_ITConfig(MBU_ST, USART_IT_RXNE, ENABLE);
  USART_ITConfig(MBU_ST, USART_IT_TXE, DISABLE);        // !! Kapalý baþlamalý
  
  // b) NVIC yakasý
  NVIC_SetPriority(MBU_IRQn, 3);
  NVIC_EnableIRQ(MBU_IRQn);
}

void MBU_IRQHandler(void)
{
  uint8_t c;
  
  if (USART_GetITStatus(MBU_ST, USART_IT_RXNE)) {
    // Timer'ý durduruyoruz
    MB_TimerStop();
    
    c = USART_ReceiveData(MBU_ST);
    
    FIFO_SetData(&_RxFifo, c);
    
    // Timer baþlatýlacak
    MB_TimerStart();
  }
  
  if (USART_GetITStatus(MBU_ST, USART_IT_TXE)) {
    c = FIFO_GetData(&_TxFifo);
    
    USART_SendData(MBU_ST, c);
    
    // Gönderilecek veri kalmadýysa TXE kesme kaynaðý kapatýlmalý
    // ve _txFlag sýfýrlanmalý
    if (FIFO_IsEmpty(&_TxFifo)) {
      USART_ITConfig(MBU_ST, USART_IT_TXE, DISABLE);
      g_TxFlag = 0;
    }
  } 
}

// MB seri portundan verilen miktarda data gönderir (kesmeli)
void MB_SendData(const void *buf, int len)
{
  const uint8_t *ptr = (const uint8_t *)buf;
  
  FIFO_Clear(&_TxFifo);
  
  while (!FIFO_IsFull(&_TxFifo) && len-- > 0)
    FIFO_SetData(&_TxFifo, *ptr++);
  
  g_TxFlag = 1;
  USART_ITConfig(MBU_ST, USART_IT_TXE, ENABLE);
}

////////////////////////////////////////////////////////////////////////////////

void MB_Init(void)
{
  MB_UartInit(MBU_BAUD);
  
  MB_TimerInit();
}

void MB_PrintADU(uint8_t *pAdu, int len)
{
  while (len--) 
    printf("%02X ", *pAdu++); 
  
  printf("\n");
}

int MB_Request(uint8_t adr, uint8_t *mb_req_pdu, uint8_t mb_req_pdu_len)
{
  uint16_t crc;
  
  if (mb_req_pdu_len > SZ_PDU)
    return 0;
  
  // PDU'yu ADU zarfýna yerleþtirmeliyiz
  _mb_req_adu[0] = adr;
  memcpy(_mb_req_adu + 1, mb_req_pdu, mb_req_pdu_len);
  
  crc = CRC16(_mb_req_adu, mb_req_pdu_len + 1);
  *(uint16_t *)(_mb_req_adu + mb_req_pdu_len + 1) = crc;
  
  _mb_req_len = mb_req_pdu_len + 3;
  MB_SendData(_mb_req_adu, _mb_req_len);
  
  // Test amaçlý
  printf("(Q) ");
  MB_PrintADU(_mb_req_adu, _mb_req_len);
  
  return 1;
}

// Geri dönüþ 0: hata, diðer baþarýlý ve pdu uzunluðu
// parametre: cevabýn yükleneceði (response) buffer adresi
int MB_Response(uint8_t *mb_rsp_adu)
{
  int i;
  
  if (_mb_rsp_len == 0)
    return 0;
  
  for (i = 0; i < _mb_rsp_len; ++i)
    _mb_rsp_adu[i] = FIFO_GetData(&_RxFifo);
  
  if (_mb_req_adu[0] != _mb_rsp_adu[0])
    return -1;
  
  if (_mb_req_adu[1] != (_mb_rsp_adu[1] & 0x7F))
      return -2;
      
  if (CRC16(_mb_rsp_adu, _mb_rsp_len))
    return -3;
      
  memcpy(mb_rsp_adu, _mb_rsp_adu, _mb_rsp_len);
  return _mb_rsp_len;
}

void Task_MB(void)
{
  static enum {
    S_INIT,
    S_WAIT_KEY,
    S_REQUEST,
    S_WAIT_RSP,
    S_RESPONSE,
    S_FUNCTION,
  } state = S_INIT;
  
  static clock_t t0, t1;
  static uint8_t mb_req_pdu[SZ_PDU];
  //static uint8_t mb_rsp_pdu[SZ_PDU];
  static uint8_t mb_rsp_adu[SZ_ADU];
  //uint8_t mb_rsp_pdu_len;
  uint8_t mb_rsp_adu_len;
  //static uint32_t count;
  
  t1 = clock();
  
  switch (state) {
  case S_INIT:
    MB_Init();
    
    state = S_WAIT_KEY;
    break;
    
  case S_WAIT_KEY:
    if (g_sButtons[0]) {
      g_sButtons[0] = 0;
      
      state = S_REQUEST;
    }
    break;
    
  case S_REQUEST:
    _mb_rsp_len = 0;    // Response clear
    
    mb_req_pdu[0] = 0x03; // Read holding registers
                          
    // 40001 + adr
    mb_req_pdu[1] = 0x00;
    mb_req_pdu[2] = 0x65;

    mb_req_pdu[3] = 0x00;
    mb_req_pdu[4] = 0x05;

    if (MB_Request(MB_DEVICE, mb_req_pdu, 5)) {
      t0 = t1;
      state = S_WAIT_RSP;
    }
    break;
    
  case S_WAIT_RSP:
    if (_mb_rsp_len)
      state = S_RESPONSE;
    else if (t1 - t0 >= MB_TIMEOUT) {
      //OLED_SetCursor(3, 0);
      printf("(R) Timeout!\n");
      state = S_WAIT_KEY;
    }
    break;
    
  case S_RESPONSE:
    mb_rsp_adu_len = MB_Response(mb_rsp_adu);
    
    if (mb_rsp_adu_len > 0) {
      //OLED_SetCursor(3, 0);
      printf("(R) ");
      MB_PrintADU(mb_rsp_adu, mb_rsp_adu_len);
      state = S_FUNCTION;
    }
    else {
      printf("Error: %d\n", mb_rsp_adu_len);    
      state = S_WAIT_KEY;
    }
    break;
    
  case S_FUNCTION:
    // Cevabý yorumla (iþle)
    //...
    state = S_WAIT_KEY;
    break;
  }
}

